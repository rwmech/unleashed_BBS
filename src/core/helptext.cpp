/*
 * ===========================================================================
 *  µnleashed BBS
 *  Electronic freedom on a microcontroller.
 * ===========================================================================
 *
 * File:         src/core/helptext.cpp
 * Module:       Core / long help
 *
 * Purpose:      GENERATED by tools/mkhelp.py from
 *               internal/long-help-2026-09-22.md. Edit the prose there and
 *               run the tool; an edit made here is lost the next time.
 *
 * Libraries:    none
 * Targets:      ESP32-WROOM-32E (ESP-IDF 5.3.1) and the Linux host build
 * See also:     helptext.h
 *
 * Copyright 2026 - Robert Mech
 * License:      GNU General Public License v3 or later
 * SPDX-License-Identifier: GPL-3.0-or-later
 * ===========================================================================
 */

#include "helptext.h"
#include "bbs_util.h"

namespace helptext {
namespace {

struct Entry { const char* verb; const char* text; };

// In flash, not DRAM: a const table of pointers to literals is placed
// in .rodata, so this costs the board program space and no RAM.
const Entry kEntries[] = {
    { "WHO", "usage: WHO [n]\nWho is on each node: rank mark, handle,\nterminal, minutes on and idle time.\nWHO n redraws the list every n seconds\nuntil you press a key. W also works." },
    { "PAGE", "usage: PAGE n message\nSends one line to the caller on node n,\nwith a bell, wherever they are: the\nprompt, chat, forums, files or mail.\nA form or a transfer holds it until\nthey are done. DND refuses pages." },
    { "OPERATOR", "usage: OPERATOR [reason]\nRings for the sysop. If they answer,\nyou talk in the chat room, the two of\nyou. If not, what you wrote is saved\nfor them. O also works; /o in the room.\nSysop: O answers a waiting ring." },
    { "G", "usage: G\nLogs off, asking Log off (Y/N)? first.\nBYE logs off without asking." },
    { "BYE", "usage: BYE [password]\nLogs off now. OFF, LOGOFF and QUIT too.\nBYE with a staff password raises your\naccess instead. A wrong password logs\nyou off; 3 wrong in 15 minutes lock\nyour address out for 15 minutes." },
    { "HELP", "usage: HELP [menu or command]\nThe menus. ? and H do the same.\nMenus: CHAT, ACCOUNT, STAFF, SYSOP,\nand ALL for every menu in turn.\nHELP with a command, such as HELP WHO,\nexplains that one command." },
    { "FORUMS", "usage: FORUMS\nThe message boards, by topic.\nEnter reads the next unread message.\nA number opens a forum or a subject;\nP posts, R replies, ? lists the keys\nand Q goes back." },
    { "FILES", "usage: FILES [n]\nThe file areas. FILES n opens area n,\nand # then a number does it from the\nmenu. In an area, L lists, a number\ndownloads that file, U uploads, ? shows\nthe keys and Q goes back. Uploads wait\nfor staff to approve. F also works." },
    { "CHAT", "usage: CHAT\nJoins the chat room. What you type goes\nto everyone there. /? lists the room's\ncommands and /q leaves. ESC clears the\nline you are typing; it does not leave." },
    { "MAIL", "usage: MAIL [handle] [text]\nYour mailbox: a list, * for new. A\nnumber reads one, Enter the oldest new,\nW writes, Q leaves. MAIL handle writes\nto them, MAIL handle text sends a line.\nNeeds an account and is not private." },
    { "WHOIS", "usage: WHOIS [handle]\nA caller's profile: name, member since,\nlast call, calls and profile text.\nWith no handle it shows your own.\nEmail, From and Phone show only on your\nown, or to staff who manage accounts." },
    { "TIME", "usage: TIME [n +m or n -m]\nThe date, time on, and time left.\nStaff: TIME n +m gives node n more\nminutes, TIME n -m takes some away.\nTIME n -1 is no limit for that call,\nnot one minute less. TIME -1 is you." },
    { "LAST", "usage: LAST\nThe last 50 calls, newest first, with\nhandle, node, when and minutes on.\nGuests are marked with a *." },
    { "CALLS", "usage: CALLS\nCalls by hour of day, as a bar chart,\nfrom the last 50 calls. It shows when\nthe board is busy, and names nobody." },
    { "INFO", "usage: INFO [n] [EDIT or CLEAR]\nThe sysop's information pages, 0 to 9.\nINFO lists them and INFO n reads one.\nI also works; /i and /i3 in the room.\nSysop: INFO n EDIT writes page n in the\neditor and INFO n CLEAR empties it." },
    { "CODES", "usage: CODES\nThe @-codes you can put in forum posts,\nmail and chat lines: colours such as\n@RED@, effects such as @BLINK:text@,\nand @BELL@, @BOARD@, @DATE@, @TIME@.\n/codes in the room shows the same." },
    { "BELL", "usage: BELL\nTurns the bell on or off for this call.\nIt covers bells other people ring:\npages, broadcasts, the chat room and\n@BELL@ in a message. /b in the chat\nroom is the same switch." },
    { "DND", "usage: DND\nPages to you off, or back on again.\nSomebody who pages you is told you are\nnot taking pages. BELL is the gentler\nchoice: pages arrive, without the bell." },
    { "PROFILE", "usage: PROFILE\nYour details: name, email, where you\nare from, phone, and profile text.\nStart picks where login puts you.\nEmail, From and Phone are seen only by\nyou and staff who manage accounts." },
    { "PASSWORD", "usage: PASSWORD\nCurrent password first, then the new\none twice. The line is not encrypted,\nso use a password you use nowhere else." },
    { "PRIVACY", "usage: PRIVACY\nWhat the board keeps about you, who can\nsee it, and what it means that the line\nis not encrypted. It is the screen\noffered when you sign up." },
    { "TERM", "usage: TERM\nYour terminal as the board sees it:\ntype, width and height, telnet on or\noff, and line speed. T also works." },
    { "BAUD", "usage: BAUD n, or BAUD OFF\nSlows the board's output to the speed\nof an old modem: 300, 1200, 2400, 9600\nor 19200. BAUD OFF is full speed again.\nOnly your line slows down." },
    { "CLS", "usage: CLS\nClears the screen. C also works." },
    { "MEM", "usage: MEM\nThe board's memory: free heap, the\nlowest it has been, session size, busy\nnodes, and free space on flash and on\nthe card if it has one. M also works." },
    { "ABOUT", "usage: ABOUT\nThe board's about screen: the software,\nits version and its licence." },
    { "FX", "usage: FX\nA demo of the screen effects the board\ncan do. Any key skips a step; Space or\nESC stops it. On a C64, Space or the\nleft arrow key." },
    { "DASH", "usage: DASH [n]\nThe whole board on one screen: time,\nmemory, each node and what it is doing,\nbans, Wi-Fi signal and the last calls.\nDASH n redraws it every n seconds until\nyou press a key." },
    { "NODES", "usage: NODES [n]\nEvery session, busy line and sysop node\nincluded, with handle, address, minutes\nleft and idle time. NODES n redraws it\nevery n seconds until you press a key." },
    { "KICK", "usage: KICK n [message]\nDisconnects the caller on node n. They\nsee Disconnected by sysop, with your\nmessage if you give one. Works on\ncallers and on staff below your rank." },
    { "SNOOP", "usage: SNOOP n\nShows you everything node n sees, as it\nhappens. Q, ESC or Ctrl-C stops.\nYour terminal type must match theirs,\none watcher per node, and only callers\nor staff below your rank." },
    { "BROADCAST", "usage: BROADCAST message\nSends a line to every caller on the\nboard, with a bell and a flashing tag,\nwherever they are: at the prompt, in\nchat, forums, files or mail, or on the\nstatus line of a form." },
    { "USERS", "usage: USERS\nThe account manager. Cursor keys move,\nEnter edits, A adds, D retires and Q\nquits. Plain ASCII gets a list instead;\nuse USER ADD, EDIT and DEL there.\nOnly accounts at your rank or below." },
    { "USER", "usage: USER ADD, EDIT h or DEL h\nADD opens a form for a new account.\nEDIT h opens account h; leave New pass\nblank to keep its password.\nDEL h retires it: no more logins, and\nthe handle is never given out again." },
    { "HIDE", "usage: HIDE\nTakes you out of WHO. To callers your\nline looks free. SHOW puts you back." },
    { "SHOW", "usage: SHOW\nLists you in WHO again and turns pages\nback on. HIDE and LURK take you out." },
    { "LURK", "usage: LURK\nHidden from WHO and not taking pages.\nLURK again turns pages back on but\nleaves you hidden; SHOW lists you." },
    { "BANS", "usage: BANS\nThe addresses banned for wrong staff\npasswords, with the minutes left on\neach. UNBAN lifts one." },
    { "UNBAN", "usage: UNBAN address\nLifts the ban on one address, written\nas four numbers, such as 192.168.1.20.\nBANS lists what is banned." },
    { "SCREENS", "usage: SCREENS [VIEW name [FLASH]]\nEvery screen by name: the size of each\n.ans, .asc and .seq and where callers\nget it: F flash, C the card's seeded\nstock copy, O the card, your own.\nVIEW plays one as your terminal gets\nit, or name.ext for that file. FLASH\nplays the stock copy under the card's." },
    { "DROP", "usage: DROP\nGives up your staff access for the rest\nof this call. The sysop moves back to a\nfree caller node. Time limits start\nagain from now." },
    { "SYS", "usage: SYS\nThe board's health on one screen:\nWi-Fi, memory, storage, load and\ntraffic, with the slowest pass of the\nloop and which part of it was slow.\nAny staff level can use it." },
    { "PLUGINS", "usage: PLUGINS\nEvery plugin built into this board, its\nversion, and whether it is running or\nwhy not. Also free space on flash." },
    { "CONFIG", "usage: CONFIG [page]\nThe board's settings, page by page.\nCONFIG lists the pages and CONFIG with\na page name, such as CONFIG chat, opens\nit. F1 saves, and most changes apply\nat once. Sysop only, never co-sysops." },
    { "SHUTDOWN", "usage: SHUTDOWN [n or CANCEL]\nWarns everyone, counts down n seconds\n(5 to 3600, default 60), then hangs up\non all callers, you too, and any file\ntransfer is lost. SHUTDOWN CANCEL stops\nit. Only a restart brings it back." },
    { "BACKUP", "usage: BACKUP SD [SCREENS]\nSaves the zip the backup window gives:\nsettings, accounts and screens, in the\ncard's backup folder. SCREENS saves the\nscreens alone. The full zip holds the\nWi-Fi password as typed." },
    { "RESTORE", "usage: RESTORE SD [SCREENS] [n]\nLists the backups on the card. With n,\nshows what backup n would replace and\nasks first. It waits while others are\non; F puts it back at once. SCREENS\nputs only screens back, onto the card,\nwhere deleting them undoes it. Staff\npasswords stay." },
    { "SD", "usage: SD [MOUNT or UNMOUNT]\nThe SD card: type, free space and where\nscreens come from, or the pins tried if\nthere is no card. SD MOUNT pauses the\nboard while it mounts; SD UNMOUNT makes\nthe card safe to pull." },
    { "ANNOUNCE", "usage: ANNOUNCE [TEST or NOW]\nWhether the board is listed in a\ndirectory and what each one said last.\nANNOUNCE TEST prints exactly what would\nbe sent and sends nothing; ANNOUNCE NOW\nsends it straight away." },
    { "CHATCLEAR", "usage: CHATCLEAR\nEmpties the chat room's memory, so new\narrivals see no earlier lines and /sh\nhas nothing to replay." },
    { "SERIAL", "usage: SERIAL [STATUS or SET]\nWatches the device on the serial port.\nT takes the keyboard when it is free,\nif you are allowed; ESC leaves.\nSERIAL STATUS shows the port settings;\nSERIAL SET 9600 8N1 changes them." },
    { "LIGHTS", "usage: LIGHTS [TEST]\nThe lights plugin's two outputs: each\none's pin, effect and brightness, and\nthe colours it was last sent, in hex.\nLIGHTS TEST shows red, green, blue and\nwhite on every pixel, a second each." },
    { "PING", "usage: PING\nExample plugin: a greeting, with its\ntick and poke counts." },
    { "POKE", "usage: POKE\nExample plugin: adds one to a count it\nkeeps in its own file, and shows it." },
    { "ECHO", "usage: ECHO\nExample plugin: what you type comes\nstraight back, in green. Q, ESC or\nCtrl-C ends it." },
    { "RAW", "usage: RAW\nExample plugin: echoes raw bytes back,\nwith no terminal handling, and counts\nthem. Ctrl-C ends it with the totals." },
    { "EXAMPLE", "usage: EXAMPLE\nExample plugin: shows its greeting\nsetting and where its file lives." },
    { "/?", "usage: /? [command]\nLists the room's commands; staff see\ntheirs too. /? and a command, such as\n/? p, explains that one. /help and /h\nalso work." },
    { "/s", "usage: /s\nWho is in the room, with away notes.\n/w and /who also work." },
    { "/p", "usage: /p n text, or /p n*\nOne line to node n in the room, seen\nby them alone. /p n* sticks: all you\ntype goes to n, and [>n] shows on your\ninput line until /p* ends it.\n/pm and /msg also work." },
    { "/me", "usage: /me text\nAn action line: /me waves shows your\nhandle between asterisks, as in\n** Daytona waves **.\nUp to five every 30 seconds." },
    { "/page", "usage: /page n why\nPages node n with a bell, the same as\nPAGE, wherever they are. /p is a line\nin the room; a page says look up.\n/pg also works." },
    { "/o", "usage: /o [reason], or /o-\nRings for the sysop, as OPERATOR does\nat the main prompt. Sysop: /o answers a\nring and /o- declines it." },
    { "/whois", "usage: /whois handle\nA caller's profile, as WHOIS shows it,\nwithout leaving the room. Email, From\nand Phone show only on your own.\n/wi also works." },
    { "/a", "usage: /a [note]\nMarks you away, with a note of up to 16\ncharacters. The room is told. /a on its\nown marks you back. /away also works." },
    { "/sq", "usage: /sq n\nHides what node n says until you leave\nthe room or type /sq n again. Arrivals,\ndepartures and room notices still show.\n/squelch also works." },
    { "/email", "usage: /email handle message\nLeaves a one-line message for a caller\nto read later, as MAIL does at the main\nprompt. Needs an account at both ends.\n/em also works." },
    { "/e", "usage: /e\nReads your oldest message, then asks\nReply, Save or Delete. Enter or ESC\nleaves it unread. /mail also works." },
    { "/sh", "usage: /sh [n]\nReplays the last n lines said in the\nroom, 20 if you leave n out. Nodes you\nhave hidden with /sq stay hidden.\n/history and /scroll also work." },
    { "/t", "usage: /t [n +m or n -m]\nThe time, and your minutes left this\ncall. Staff: /t n +m and /t n -m give\nor take node n's minutes, as TIME does,\nand /t n -1 means no limit that call.\n/time also works." },
    { "/b", "usage: /b, or /b handle\nTurns the bell on or off: the same\nswitch as BELL. /bell also works.\nStaff: /b handle bars that handle from\nthe room and puts them out if they are\nin it. /ban handle does the same." },
    { "/i", "usage: /i [n]\nThe information pages: /i lists them,\n/i3 reads page 3, the same as INFO.\nSysop: /i3- empties page 3. Writing\none is INFO 3 EDIT at the main prompt." },
    { "/codes", "usage: /codes\nThe @-codes you can use in chat lines,\nmail and forum posts, such as @RED@ or\n@BLINK:text@. The same list as CODES." },
    { "/clear", "usage: /clear\nClears your screen, not anyone else's.\n/cls also works." },
    { "/welcome", "usage: /welcome\nShows the room's welcome screen again,\nif this board has one.\n/intro also works." },
    { "/q", "usage: /q\nLeaves the room for the main prompt.\n/quit also works. ESC does not leave:\nit clears the line you are typing." },
    { "/q+", "usage: /q+\nLeaves the room and logs off in one go,\nwith the same send-off as BYE. The room\nsees you log off. /quit+ also works." },
    { "/vk", "usage: /vk n\nVotes to put node n out of the room.\nWorks with no staff present and three\nor more in the room. Two thirds of the\nothers must vote within 60 seconds.\nThey can come back. /votekick works." },
    { "/k", "usage: /k n [why]\nPuts node n out of the room and back at\nthe main prompt, with any reason given.\nOnly callers and staff below your rank.\n/kick also works." },
    { "/unb", "usage: /unb handle\nLets a barred handle back into the\nroom. /unban also works." },
    { "/bans", "usage: /bans\nThe handles barred from the room. This\nis the room's list, not a board ban." },
};

} // namespace

const char* find(const char* verb) {
    if (!verb || !*verb) return nullptr;
    for (const Entry& e : kEntries)
        if (bbsu::ieq(e.verb, verb)) return e.text;
    return nullptr;
}

} // namespace helptext
